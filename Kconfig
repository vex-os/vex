## kernel/Kconfig
```kconfig
source "kernel/arch/$(ARCH)/Kconfig"

# Capabilities, selected by architecture code

config ARCH_HAS_SMP
    bool

config ARCH_HAS_DEBUGCON
    bool

menu "Processes and scheduling"
source "kernel/proc/Kconfig"
endmenu

menu "Console and logging"
source "kernel/core/Kconfig"
endmenu

menu "Block devices"
source "kernel/dev/Kconfig"
endmenu

menu "Device drivers"
source "kernel/drivers/Kconfig"
endmenu

menu "Filesystems"
source "kernel/fs/Kconfig"
endmenu

menu "Debugging"

config KASSERT
    bool "Kernel assertions"
    default y
    help
      Check kassert() conditions at runtime and panic
      with the failed expression when one does not hold

comment "Tracing"

config TRACE_BLK_EVENTS
    bool "Trace block device events"
    help
      Log block devices being added and removed;
      shown only with loglevel=verbose

config TRACE_CHR_EVENTS
    bool "Trace character device events"
    help
      Log character devices being added and removed;
      shown only with loglevel=verbose

config TRACE_INITCALLS
    bool "Trace initcalls"
    help
      Log every initcall before it runs, which helps to find
      the one a boot hangs in; shown only with loglevel=verbose

endmenu
```

## kernel/arch/amd64/Kconfig
```kconfig
config ARCH_AMD64
    def_bool y
    select ARCH_HAS_SMP
    select ARCH_HAS_DEBUGCON
```

## kernel/bus/Kconfig
```kconfig
config PCI
    bool "PCI"
    default y
    help
      PCI and PCI Express devices below the host bridges the
      firmware describes, with the bridges between them

config ISA
    bool "ISA"
    depends on PCI
    default y
    help
      Devices behind a PCI-ISA bridge as the firmware describes
      them, such as the PS/2 controller and COM ports of the
      chipset
```

## kernel/core/Kconfig
```kconfig
config KPRINTF_BUFSIZE
    int "Kernel log buffer size (bytes)"
    range 256 1048576
    default 4096
    help
      Ring buffer of recent kernel messages, replayed to
      consoles that register or unblank later

comment "Consoles"

config FBCONS
    bool "Framebuffer console"
    default y
    help
      Print kernel messages to the framebuffer
      provided by the bootloader

config BXCONS
    bool "Bochs debug port console"
    depends on ARCH_HAS_DEBUGCON
    default y
    help
      Print kernel messages to the debug I/O port, which
      QEMU and Bochs can redirect to a file or stdio

comment "Firmware"

config UACPI_QUIET
    bool "Silence uACPI log messages"
    default y
    help
      Drop the messages uACPI logs while it parses
      and runs the firmware ACPI tables
```

## kernel/dev/Kconfig
```kconfig
comment "Partition tables"

config PTABLE_GPT
    bool "GUID partition tables"
    default y
    help
      Expose the partitions of a GPT disk
      as block devices of their own

config PTABLE_MBR
    bool "MBR partition tables"
    default y
    help
      Expose the four primary partitions of an MBR disk
      as block devices of their own
```

## kernel/drivers/Kconfig
```kconfig
menu "Storage"
source "kernel/drivers/storage/Kconfig"
endmenu

menu "Display"
source "kernel/drivers/display/Kconfig"
endmenu

menu "Input"
source "kernel/drivers/input/Kconfig"
endmenu
```

## kernel/drivers/display/Kconfig
```kconfig
config LIMINEFB
    bool "Limine framebuffers"
    default y
    help
      The framebuffers the bootloader set up, as fbd devices
      unless a native display driver takes their memory over

config BOCHSFB
    bool "Bochs and QEMU standard VGA"
    default y
    help
      The Bochs display of QEMU's -vga std, secondary-vga and
      bochs-display, in the mode the firmware set; it takes the
      screen over from the boot framebuffer on the same memory
```

## kernel/drivers/input/Kconfig
```kconfig
config PS2KBD
    bool "PS/2 keyboard"
    default y
    help
      Keyboard on the first port of
      the PS/2 (i8042) controller
```

## kernel/drivers/serial/Kconfig
```kconfig
config SERIAL_TEST
    bool "Test serial port"
    default y
    help
      A serial port, serial0, and its far end as a raw device,
      serialtest: what serialtest is written comes in on the
      port, reading it gives what the port sent, and an ioctl
      on it receives a byte with a line error. For the
      userspace tests of serial ports and terminals

config UART16550
    bool "16550 UARTs"
    default y
    help
      Serial ports on a 16550 or a compatible UART, such as
      the COM ports of a PC as the firmware describes them

config UART16550_PCI
    bool "16550 UARTs on PCI serial cards"
    depends on UART16550 && PCI
    default y
    help
      PCI serial controllers of the 16550 interface, and the
      pci-serial cards of QEMU with up to four ports
```

## kernel/drivers/storage/Kconfig
```kconfig
config AHCI
    bool "AHCI SATA controllers"
    depends on PCI
    default y
    help
      SATA disks and ATAPI drives behind an AHCI host
      bus adapter, the usual controller on PCI(e) machines

config PATA
    bool "Parallel ATA (IDE) controllers"
    depends on PCI
    default y
    help
      ATA disks and ATAPI drives on the channels of a PCI IDE
      controller, in compatibility or native mode, and on IDE
      channels that the firmware or fixed= describes
```

## kernel/fs/Kconfig
```kconfig
menu "Filesystems"

config VCACHE_MAX_UNUSED
    int "Unused vnodes kept cached"
    range 0 1048576
    default 1024
    help
      Vnodes that nobody holds stay cached up to this many,
      so looking the same paths up again needs no disk access

config FCACHE_WRITEBACK_MSEC
    int "File cache writeback interval (ms)"
    range 100 600000
    default 5000
    help
      How often dirty file pages and filesystem
      metadata are written back to disk

config FCACHE_DIRTY_PERCENT
    int "Dirty file cache limit (percent of memory)"
    range 1 90
    default 20
    help
      A write that finds more of memory dirty than this
      writes its own file back before returning

choice
    prompt "Access time updates on read"
    default ATIME_RELATIME
    help
      Whether reading a file or a directory moves its
      access time, which costs an inode write when it does

config ATIME_RELATIME
    bool "relatime"
    help
      Only when the access time is not past the last change,
      or is older than ATIME_RELATIME_INTERVAL; as in Linux

config ATIME_STRICT
    bool "strictatime"
    help
      On every read, as POSIX asks

config ATIME_NONE
    bool "noatime"
    help
      Never; only utimensat and file creation set it

endchoice

config ATIME_RELATIME_INTERVAL
    int "Relatime update interval (seconds)"
    depends on ATIME_RELATIME
    range 1 31536000
    default 86400
    help
      An access time this much older than now is moved
      even when the file has not changed since

config DEVFS
    bool "Device filesystem"
    default y

config ECHFS
    bool "echfs"
    default y

config EXT2
    bool "ext2"
    default y

config FAT
    bool "FAT"
    default y

endmenu
```

## kernel/proc/Kconfig
```kconfig
comment "Processors"

config SMP
    bool "Symmetric multiprocessing"
    depends on ARCH_HAS_SMP
    default y
    help
      Bring up and schedule on all harts reported by firmware.
      Without this only the bootstrap hart is used

config MAX_HARTS
    int "Maximum number of harts"
    depends on SMP
    range 2 4096
    default 64
    help
      Hart state is allocated statically for this many harts;
      the ones firmware reports past it are left unused

config SCHED_TIMESLICE
    int "Scheduler timeslice (us)"
    range 100 1000000
    default 5000
    help
      How long a thread runs before the scheduler
      lets another runnable thread on the same hart

comment "Processes"

config DEFAULT_INIT
    string "Default init path"
    default "/sbin/init"
    help
      Path to the first userspace process, used when the
      kernel command line does not specify init=

config MAX_THREADS
    int "Maximum number of threads"
    range 32 65536
    default 16384
    help
      Every thread takes a kernel stack slot in a region of fixed
      size, so this caps kernel and user threads together; a multiple of 32

config MAX_FDS
    int "Maximum open file descriptors per process"
    range 16 1048576
    default 1024
    help
      Opening or duplicating a descriptor at or past
      this number fails with EMFILE or EBADF

config NGROUPS_MAX
    int "Maximum supplementary groups per process"
    range 0 65536
    default 64
    help
      Starting limit for setgroups. The list lives inside the credentials
      object, so a long one moves it from the slab allocator to the heap

comment "Stacks"

config KSTACK_PAGES
    int "Kernel stack size (pages)"
    range 2 64
    default 4
    help
      Pages in the kernel stack of every thread,
      not counting the unmapped guard page below it

config USER_STACK_SIZE
    int "User stack size (KiB)"
    range 4 1048576
    default 8192
    help
      Address space reserved for the stack of a new process,
      a power of two; pages are only allocated once touched
```
